## sdkconfig.defaults
```kconfig
# LVGL
CONFIG_LV_COLOR_DEPTH_16=y
CONFIG_LV_COLOR_16_SWAP=y
CONFIG_LV_USE_THEME_DEFAULT=y
CONFIG_LV_USE_FONT_MONTSERRAT=y
CONFIG_LV_FONT_MONTSERRAT_14=y
CONFIG_LV_FONT_MONTSERRAT_16=y
CONFIG_LV_FONT_MONTSERRAT_20=y
CONFIG_LV_MEM_SIZE_KILOBYTES=128
CONFIG_LV_ATTRIBUTE_FAST_MEM_USE_IRAM=y

# PSRAM — enable for display buffer
CONFIG_SPIRAM=y
CONFIG_SPIRAM_MODE_OCT=y
CONFIG_SPIRAM_SPEED_80M=y

# Allow larger stack for LVGL task
CONFIG_ESP_MAIN_TASK_STACK_SIZE=8192
```
